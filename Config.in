## Config.in
```kconfig
source "$BR2_EXTERNAL_BERNARDO_PATH/package/beaglelogic/Config.in"
source "$BR2_EXTERNAL_BERNARDO_PATH/package/inputevent/Config.in"
source "$BR2_EXTERNAL_BERNARDO_PATH/package/uart-echo-test/Config.in"
source "$BR2_EXTERNAL_BERNARDO_PATH/package/uart-enable-rs485/Config.in"
```

## configs/bernardo_defconfig
```kconfig
BR2_arm=y
BR2_cortex_a8=y
BR2_GLOBAL_PATCH_DIR="$(BR2_EXTERNAL_BERNARDO_PATH)/board/bernardo/patches"
BR2_PACKAGE_HOST_LINUX_HEADERS_CUSTOM_4_9=y
BR2_TOOLCHAIN_BUILDROOT_WCHAR=y
BR2_TOOLCHAIN_BUILDROOT_CXX=y
BR2_TARGET_GENERIC_HOSTNAME="bernardo"
BR2_TARGET_GENERIC_ISSUE="Welcome to Bernardo"
BR2_TARGET_GENERIC_PASSWD_SHA256=y
BR2_ROOTFS_DEVICE_CREATION_DYNAMIC_EUDEV=y
BR2_TARGET_GENERIC_GETTY_PORT="ttyS0"
BR2_SYSTEM_DHCP="eth0"
BR2_ROOTFS_OVERLAY="$(BR2_EXTERNAL_BERNARDO_PATH)/board/bernardo/rootfs_overlay"
BR2_ROOTFS_POST_BUILD_SCRIPT="$(BR2_EXTERNAL_BERNARDO_PATH)/board/bernardo/post-build.sh"
BR2_ROOTFS_POST_IMAGE_SCRIPT="$(BR2_EXTERNAL_BERNARDO_PATH)/board/bernardo/post-image.sh"
BR2_LINUX_KERNEL=y
BR2_LINUX_KERNEL_CUSTOM_GIT=y
BR2_LINUX_KERNEL_CUSTOM_REPO_URL="https://github.com/RobertCNelson/linux-stable-rcn-ee"
BR2_LINUX_KERNEL_CUSTOM_REPO_VERSION="4.9.36-ti-r46"
BR2_LINUX_KERNEL_USE_CUSTOM_CONFIG=y
BR2_LINUX_KERNEL_CUSTOM_CONFIG_FILE="$(BR2_EXTERNAL_BERNARDO_PATH)/board/bernardo/kernel.config"
BR2_LINUX_KERNEL_DTS_SUPPORT=y
BR2_LINUX_KERNEL_USE_CUSTOM_DTS=y
BR2_LINUX_KERNEL_CUSTOM_DTS_PATH="$(BR2_EXTERNAL_BERNARDO_PATH)/board/bernardo/bernardo.dts"
BR2_PACKAGE_BUSYBOX_CONFIG="$(BR2_EXTERNAL_BERNARDO_PATH)/board/bernardo/busybox.config"
BR2_PACKAGE_SIGROK_CLI=y
BR2_PACKAGE_SPI_TOOLS=y
BR2_PACKAGE_AVAHI=y
BR2_PACKAGE_AVAHI_DAEMON=y
BR2_PACKAGE_DROPBEAR=y
BR2_PACKAGE_DROPBEAR_DISABLE_REVERSEDNS=y
BR2_PACKAGE_DROPBEAR_WTMP=y
BR2_PACKAGE_NTP=y
BR2_PACKAGE_RSYNC=y
BR2_TARGET_ROOTFS_EXT2=y
BR2_TARGET_ROOTFS_EXT2_4=y
BR2_TARGET_ROOTFS_EXT2_SIZE="250M"
# BR2_TARGET_ROOTFS_TAR is not set
BR2_TARGET_UBOOT=y
BR2_TARGET_UBOOT_BUILD_SYSTEM_KCONFIG=y
BR2_TARGET_UBOOT_CUSTOM_GIT=y
BR2_TARGET_UBOOT_CUSTOM_REPO_URL="https://github.com/u-boot/u-boot"
BR2_TARGET_UBOOT_CUSTOM_REPO_VERSION="v2018.01"
BR2_TARGET_UBOOT_PATCH="$(BR2_EXTERNAL_BERNARDO_PATH)/board/bernardo/u-boot"
BR2_TARGET_UBOOT_BOARD_DEFCONFIG="am335x_boneblack"
BR2_TARGET_UBOOT_NEEDS_DTC=y
# BR2_TARGET_UBOOT_FORMAT_BIN is not set
BR2_TARGET_UBOOT_FORMAT_IMG=y
BR2_TARGET_UBOOT_FORMAT_CUSTOM=y
BR2_TARGET_UBOOT_FORMAT_CUSTOM_NAME="spl/u-boot-spl.bin"
BR2_TARGET_UBOOT_SPL=y
BR2_TARGET_UBOOT_SPL_NAME="MLO"
BR2_PACKAGE_HOST_DOSFSTOOLS=y
BR2_PACKAGE_HOST_GENIMAGE=y
BR2_PACKAGE_HOST_MTOOLS=y
BR2_PACKAGE_BEAGLELOGIC=y
BR2_PACKAGE_INPUTEVENT=y
```

## package/beaglelogic/Config.in
```kconfig
config BR2_PACKAGE_BEAGLELOGIC
	bool "beaglelogic"
    select BR2_PACKAGE_HOST_TI_CGT_PRU
    select BR2_PACKAGE_HOST_PRU_SOFTWARE_SUPPORT
	help
	  Beaglelogic
```

## package/uart-echo-test/Config.in
```kconfig
config BR2_PACKAGE_UART_ECHO_TEST
	bool "uart-echo-test"
	help
	  Uart echo test
```

## package/uart-enable-rs485/Config.in
```kconfig
config BR2_PACKAGE_UART_ENABLE_RS485
	bool "uart-enable-rs485"
	help
	  Enable RS485 mode on a uart
```
